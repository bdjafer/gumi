## devices/omi-cv1/firmware/gumi/zephyr/omi-v3012/tests/codec-port-emulator/testcase.yaml
```yaml
tests:
  gumi.omi_cv1.codec_port.lifecycle:
    tags:
      - gumi
      - omi_cv1
      - codec
    platform_allow:
      - mps3/an547
    harness: ztest
```

## devices/omi-cv1/firmware/gumi/zephyr/omi-v3012/tests/functional-recording-link/Kconfig
```kconfig
source "Kconfig.zephyr"

config OMI_CODEC_OPUS
    bool "Pinned Omi Opus codec"
    default y

if BOARD_OMI_NRF5340_CPUAPP || BOARD_OMI_NRF5340_CPUAPP_NS

config DOMAIN_CPUNET_BOARD
    string
    default "omi/nrf5340/cpunet"
    help
      Exact Omi network-core board used by the NCS Bluetooth child image.

endif
```

## devices/omi-cv1/firmware/gumi/zephyr/omi-v3012/tests/functional-recording-link/testcase.yaml
```yaml
tests:
  gumi.omi_v3012.functional_recording_link:
    build_only: true
    platform_allow:
      - omi/nrf5340/cpuapp
    tags:
      - gumi
      - omi
      - functional
```

## devices/omi-cv1/firmware/gumi/zephyr/omi-v3012/tests/recording-storage-port-link/testcase.yaml
```yaml
tests:
  gumi.omi_cv1.recording_storage_port.link:
    tags:
      - gumi
      - omi_cv1
      - storage
    platform_allow:
      - omi/nrf5340/cpuapp
    build_only: true
```

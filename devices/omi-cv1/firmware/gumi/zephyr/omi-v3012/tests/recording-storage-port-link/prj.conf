## CMakeLists.txt
```
cmake_minimum_required(VERSION 3.20.0)
find_package(Zephyr REQUIRED HINTS $ENV{ZEPHYR_BASE})
project(gumi_omi_v3012_recording_storage_port_link)

if(NOT DEFINED GUMI_FIRMWARE_DIR)
    message(FATAL_ERROR "GUMI_FIRMWARE_DIR is required")
endif()

target_sources(app PRIVATE
    src/main.c
    ${GUMI_FIRMWARE_DIR}/src/recording_journal.c
    ${GUMI_FIRMWARE_DIR}/src/recording_store.c
    ${GUMI_FIRMWARE_DIR}/zephyr/omi-v3012/src/crypto_port.c
    ${GUMI_FIRMWARE_DIR}/zephyr/omi-v3012/src/recording_key_port.c
    ${GUMI_FIRMWARE_DIR}/zephyr/omi-v3012/src/recording_storage_pm_policy.c
    ${GUMI_FIRMWARE_DIR}/zephyr/omi-v3012/src/recording_storage_port.c
)
target_include_directories(app PRIVATE
    ${GUMI_FIRMWARE_DIR}/include
    ${GUMI_FIRMWARE_DIR}/zephyr/omi-v3012/include
)
```

## prj.conf
```kconfig
CONFIG_MAIN_STACK_SIZE=4096
CONFIG_HEAP_MEM_POOL_SIZE=8192

CONFIG_GPIO=y
CONFIG_SPI=y
CONFIG_SPI_NRFX=y
CONFIG_PM_DEVICE=y
CONFIG_FLASH=y
CONFIG_FLASH_JESD216_API=y

CONFIG_DISK_ACCESS=y
CONFIG_DISK_DRIVER_SDMMC=y
CONFIG_FILE_SYSTEM=y
CONFIG_FAT_FILESYSTEM_ELM=y
CONFIG_FILE_SYSTEM_MKFS=n
CONFIG_FS_FATFS_MKFS=n
CONFIG_FS_FATFS_MOUNT_MKFS=n

CONFIG_NRF_SECURITY=y
CONFIG_MBEDTLS_PSA_CRYPTO_C=y
CONFIG_PSA_WANT_GENERATE_RANDOM=y
CONFIG_PSA_WANT_KEY_TYPE_AES=y
CONFIG_PSA_WANT_ALG_GCM=y

CONFIG_MPU_ALLOW_FLASH_WRITE=y
CONFIG_HW_UNIQUE_KEY=y
CONFIG_HW_UNIQUE_KEY_WRITE_ON_CRYPTO_INIT=n
CONFIG_HW_UNIQUE_KEY_RANDOM=n
```

## src/main.c
```c
#include "gumi/omi_v3012_recording_storage.h"
#include "gumi/omi_v3012_recording_key.h"

int main(void)
{
    return gumi_omi_v3012_recording_storage_get_truth() ==
                   GUMI_OMI_V3012_RECORDING_STORAGE_UNINITIALIZED &&
               gumi_omi_v3012_recording_storage_last_error() == 0 &&
               gumi_omi_v3012_recording_key_get_truth() ==
                   GUMI_OMI_V3012_RECORDING_KEY_UNINITIALIZED
        ? 0
        : 1;
}
```
